/ {
    chosen {
        zmk,matrix = &key_matrix;
    };

    key_matrix: matrix {
        compatible = "zmk,matrix";
        label = "Quefrency Right Matrix";

        rows = <5>;
        cols = <6>;

        row-gpios = <&gpio0 5 (GPIO_ACTIVE_LOW)>,
                    <&gpio0 6 (GPIO_ACTIVE_LOW)>,
                    <&gpio0 7 (GPIO_ACTIVE_LOW)>,
                    <&gpio1 0 (GPIO_ACTIVE_LOW)>,
                    <&gpio1 1 (GPIO_ACTIVE_LOW)>;

        col-gpios = <&gpio1 6 (GPIO_ACTIVE_LOW)>,
                    <&gpio1 7 (GPIO_ACTIVE_LOW)>,
                    <&gpio1 8 (GPIO_ACTIVE_LOW)>,
                    <&gpio1 9 (GPIO_ACTIVE_LOW)>,
                    <&gpio1 10 (GPIO_ACTIVE_LOW)>,
                    <&gpio1 11 (GPIO_ACTIVE_LOW)>;
    };
};
